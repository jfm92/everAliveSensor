## demo/BLERouter/sdkconfig.defaults
```kconfig
# CPU
CONFIG_ESP_DEFAULT_CPU_FREQ_MHZ_160=y
CONFIG_ESP_DEFAULT_CPU_FREQ_MHZ=160

# Bootloader
CONFIG_BOOTLOADER_LOG_LEVEL_NONE=y
CONFIG_BOOTLOADER_LOG_LEVEL=0

# Flash
CONFIG_ESPTOOLPY_FLASHFREQ_80M=y
CONFIG_ESPTOOLPY_FLASHFREQ="80m"
CONFIG_ESPTOOLPY_FLASHMODE_QIO=y
CONFIG_ESPTOOLPY_FLASHMODE="qio"

# WiFi
CONFIG_ESP_WIFI_ENABLED=y
CONFIG_ESP_WIFI_STATIC_RX_BUFFER_NUM=4
CONFIG_ESP_WIFI_DYNAMIC_RX_BUFFER_NUM=8

# NimBLE — observer only (ROLE_CENTRAL=y required on ESP32: host privacy is
# unconditionally enabled for this target, pulling in ble_hs_resolv.c which
# calls ble_sm_alg_encrypt; that symbol only compiles when NIMBLE_BLE_CONNECT=1,
# i.e. ROLE_CENTRAL or ROLE_PERIPHERAL is set. MAX_CONNECTIONS=0 prevents
# actual connections from being established.)
CONFIG_BT_ENABLED=y
CONFIG_BT_NIMBLE_ENABLED=y
CONFIG_BT_CONTROLLER_ENABLED=y
CONFIG_BT_NIMBLE_ROLE_OBSERVER=y
CONFIG_BT_NIMBLE_ROLE_BROADCASTER=n
CONFIG_BT_NIMBLE_ROLE_CENTRAL=y
CONFIG_BT_NIMBLE_ROLE_PERIPHERAL=n
CONFIG_BT_NIMBLE_MAX_CONNECTIONS=0

# Partition table — binary > 1 MB so the default singleapp (1 MB) overflows
CONFIG_PARTITION_TABLE_SINGLE_APP_LARGE=y

# FreeRTOS
CONFIG_FREERTOS_HZ=1000
```
